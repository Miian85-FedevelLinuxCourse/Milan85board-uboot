## board/Miian85-FedevelLinuxCourse/milan85board/Kconfig
```kconfig
if TARGET_MILAN85BOARD

config SYS_BOARD
	default "milan85board"

config SYS_VENDOR
	default "Miian85-FedevelLinuxCourse"

config SYS_CONFIG_NAME
	default "milan85board"

endif
```

## configs/mx6dlmilan85board_defconfig
```kconfig
CONFIG_ARM=y
CONFIG_ARCH_MX6=y
CONFIG_TARGET_MILAN85BOARD=y
CONFIG_SYS_EXTRA_OPTIONS="IMX_CONFIG=board/Miian85-FedevelLinuxCourse/milan85board/mx6dlmilan85board.cfg,MX6DL"
# CONFIG_CMD_IMLS is not set
# CONFIG_CMD_FLASH is not set
CONFIG_SPI_FLASH=y
```

## configs/mx6qmilan85board_defconfig
```kconfig
CONFIG_ARM=y
CONFIG_ARCH_MX6=y
CONFIG_TARGET_MILAN85BOARD=y
CONFIG_SYS_EXTRA_OPTIONS="IMX_CONFIG=board/Miian85-FedevelLinuxCourse/milan85board/mx6q_1x_mt29pzzz4d4bkesk.cfg,MX6Q"
# CONFIG_CMD_IMLS is not set
# CONFIG_CMD_FLASH is not set
CONFIG_SPI_FLASH=y
```
